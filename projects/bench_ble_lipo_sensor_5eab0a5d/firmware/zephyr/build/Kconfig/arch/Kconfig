## projects/bench_ble_lipo_sensor_5eab0a5d/firmware/zephyr/build/Kconfig/arch/Kconfig
```kconfig
# Load Zephyr Arch Kconfig descriptions.
osource "/Users/mrcha033/Documents/hw-cli/.toolchains/zephyr/arch/rx/Kconfig"
osource "/Users/mrcha033/Documents/hw-cli/.toolchains/zephyr/arch/x86/Kconfig"
osource "/Users/mrcha033/Documents/hw-cli/.toolchains/zephyr/arch/xtensa/Kconfig"
osource "/Users/mrcha033/Documents/hw-cli/.toolchains/zephyr/arch/sparc/Kconfig"
osource "/Users/mrcha033/Documents/hw-cli/.toolchains/zephyr/arch/riscv/Kconfig"
osource "/Users/mrcha033/Documents/hw-cli/.toolchains/zephyr/arch/posix/Kconfig"
osource "/Users/mrcha033/Documents/hw-cli/.toolchains/zephyr/arch/mips/Kconfig"
osource "/Users/mrcha033/Documents/hw-cli/.toolchains/zephyr/arch/arm64/Kconfig"
osource "/Users/mrcha033/Documents/hw-cli/.toolchains/zephyr/arch/arm/Kconfig"
osource "/Users/mrcha033/Documents/hw-cli/.toolchains/zephyr/arch/arc/Kconfig"
```

## projects/bench_ble_lipo_sensor_5eab0a5d/firmware/zephyr/build/Kconfig/boards/Kconfig.defconfig
```kconfig
# Load Zephyr board defconfig descriptions.
osource "/Users/mrcha033/Documents/hw-cli/.toolchains/zephyr/boards/nordic/nrf52840dk/Kconfig.defconfig"
```

## projects/bench_ble_lipo_sensor_5eab0a5d/firmware/zephyr/build/Kconfig/boards/Kconfig.nrf52840dk
```kconfig
# Load board Kconfig descriptions.
osource "/Users/mrcha033/Documents/hw-cli/.toolchains/zephyr/boards/nordic/nrf52840dk/Kconfig.nrf52840dk"
```

## projects/bench_ble_lipo_sensor_5eab0a5d/firmware/zephyr/build/Kconfig/boards/Kconfig.sysbuild
```kconfig
# Load Sysbuild board Kconfig descriptions.
osource "/Users/mrcha033/Documents/hw-cli/.toolchains/zephyr/boards/nordic/nrf52840dk/Kconfig.sysbuild"
```

## projects/bench_robotics_controller_5eab0a5d/firmware/zephyr/build/Kconfig/Kconfig.modules
```kconfig
config ZEPHYR_HAL_STM32_MODULE
	bool
	default y

config ZEPHYR_HAL_STM32_MODULE_BLOBS
	bool
menu "cmsis_6 (/Users/mrcha033/Documents/hw-cli/.toolchains/zephyr/modules/hal/cmsis_6)"
osource "$(ZEPHYR_CMSIS_6_KCONFIG)"
config ZEPHYR_CMSIS_6_MODULE
	bool
	default y
endmenu
```

## projects/bench_robotics_controller_5eab0a5d/firmware/zephyr/build/Kconfig/boards/Kconfig
```kconfig
# Load Zephyr board Kconfig descriptions.
osource "/Users/mrcha033/Documents/hw-cli/.toolchains/zephyr/boards/st/nucleo_h743zi/Kconfig"
```

## projects/bench_robotics_controller_5eab0a5d/firmware/zephyr/build/Kconfig/soc/Kconfig
```kconfig
# Load Zephyr SoC Kconfig descriptions.
osource "/Users/mrcha033/Documents/hw-cli/.toolchains/zephyr/soc/xlnx/zynqmp/Kconfig"
osource "/Users/mrcha033/Documents/hw-cli/.toolchains/zephyr/soc/xlnx/zynq7000/Kconfig"
osource "/Users/mrcha033/Documents/hw-cli/.toolchains/zephyr/soc/xlnx/versalnet/Kconfig"
osource "/Users/mrcha033/Documents/hw-cli/.toolchains/zephyr/soc/xlnx/versal2/Kconfig"
osource "/Users/mrcha033/Documents/hw-cli/.toolchains/zephyr/soc/xen/Kconfig"
osource "/Users/mrcha033/Documents/hw-cli/.toolchains/zephyr/soc/wch/ch32v/Kconfig"
osource "/Users/mrcha033/Documents/hw-cli/.toolchains/zephyr/soc/ti/simplelink/Kconfig"
osource "/Users/mrcha033/Documents/hw-cli/.toolchains/zephyr/soc/ti/mspm0/Kconfig"
osource "/Users/mrcha033/Documents/hw-cli/.toolchains/zephyr/soc/ti/lm3s6965/Kconfig"
osource "/Users/mrcha033/Documents/hw-cli/.toolchains/zephyr/soc/ti/k3/Kconfig"
osource "/Users/mrcha033/Documents/hw-cli/.toolchains/zephyr/soc/telink/tlsr/Kconfig"
osource "/Users/mrcha033/Documents/hw-cli/.toolchains/zephyr/soc/starfive/jh71xx/Kconfig"
osource "/Users/mrcha033/Documents/hw-cli/.toolchains/zephyr/soc/st/stm32/Kconfig"
osource "/Users/mrcha033/Documents/hw-cli/.toolchains/zephyr/soc/snps/qemu_arc/Kconfig"
osource "/Users/mrcha033/Documents/hw-cli/.toolchains/zephyr/soc/snps/nsim/arc_v/Kconfig"
osource "/Users/mrcha033/Documents/hw-cli/.toolchains/zephyr/soc/snps/nsim/arc_classic/Kconfig"
osource "/Users/mrcha033/Documents/hw-cli/.toolchains/zephyr/soc/snps/hsdk4xd/Kconfig"
osource "/Users/mrcha033/Documents/hw-cli/.toolchains/zephyr/soc/snps/hsdk/Kconfig"
osource "/Users/mrcha033/Documents/hw-cli/.toolchains/zephyr/soc/snps/emsk/Kconfig"
osource "/Users/mrcha033/Documents/hw-cli/.toolchains/zephyr/soc/snps/emsdp/Kconfig"
osource "/Users/mrcha033/Documents/hw-cli/.toolchains/zephyr/soc/snps/arc_iot/Kconfig"
osource "/Users/mrcha033/Documents/hw-cli/.toolchains/zephyr/soc/silabs/Kconfig"
osource "/Users/mrcha033/Documents/hw-cli/.toolchains/zephyr/soc/sifive/sifive_freedom/Kconfig"
osource "/Users/mrcha033/Documents/hw-cli/.toolchains/zephyr/soc/sensry/Kconfig"
osource "/Users/mrcha033/Documents/hw-cli/.toolchains/zephyr/soc/rockchip/Kconfig"
osource "/Users/mrcha033/Documents/hw-cli/.toolchains/zephyr/soc/renode/riscv_virtual/Kconfig"
osource "/Users/mrcha033/Documents/hw-cli/.toolchains/zephyr/soc/renode/cortex_r8_virtual/Kconfig"
osource "/Users/mrcha033/Documents/hw-cli/.toolchains/zephyr/soc/renesas/smartbond/Kconfig"
osource "/Users/mrcha033/Documents/hw-cli/.toolchains/zephyr/soc/renesas/rz/Kconfig"
osource "/Users/mrcha033/Documents/hw-cli/.toolchains/zephyr/soc/renesas/rx/Kconfig"
osource "/Users/mrcha033/Documents/hw-cli/.toolchains/zephyr/soc/renesas/rcar/Kconfig"
osource "/Users/mrcha033/Documents/hw-cli/.toolchains/zephyr/soc/renesas/ra/Kconfig"
osource "/Users/mrcha033/Documents/hw-cli/.toolchains/zephyr/soc/realtek/ec/Kconfig"
osource "/Users/mrcha033/Documents/hw-cli/.toolchains/zephyr/soc/raspberrypi/rpi_pico/Kconfig"
osource "/Users/mrcha033/Documents/hw-cli/.toolchains/zephyr/soc/quicklogic/eos_s3/Kconfig"
osource "/Users/mrcha033/Documents/hw-cli/.toolchains/zephyr/soc/qemu/virt_riscv/Kconfig"
osource "/Users/mrcha033/Documents/hw-cli/.toolchains/zephyr/soc/qemu/malta/Kconfig"
osource "/Users/mrcha033/Documents/hw-cli/.toolchains/zephyr/soc/openisa/rv32m1/Kconfig"
osource "/Users/mrcha033/Documents/hw-cli/.toolchains/zephyr/soc/openhwgroup/cva6/Kconfig"
osource "/Users/mrcha033/Documents/hw-cli/.toolchains/zephyr/soc/oct/osd32mp15x/Kconfig"
osource "/Users/mrcha033/Documents/hw-cli/.toolchains/zephyr/soc/nxp/s32/Kconfig"
osource "/Users/mrcha033/Documents/hw-cli/.toolchains/zephyr/soc/nxp/rw/Kconfig"
osource "/Users/mrcha033/Documents/hw-cli/.toolchains/zephyr/soc/nxp/mcx/Kconfig"
osource "/Users/mrcha033/Documents/hw-cli/.toolchains/zephyr/soc/nxp/lpc/Kconfig"
osource "/Users/mrcha033/Documents/hw-cli/.toolchains/zephyr/soc/nxp/layerscape/Kconfig"
osource "/Users/mrcha033/Documents/hw-cli/.toolchains/zephyr/soc/nxp/kinetis/Kconfig"
osource "/Users/mrcha033/Documents/hw-cli/.toolchains/zephyr/soc/nxp/imxrt/Kconfig"
osource "/Users/mrcha033/Documents/hw-cli/.toolchains/zephyr/soc/nxp/imx/Kconfig"
osource "/Users/mrcha033/Documents/hw-cli/.toolchains/zephyr/soc/nuvoton/numicro/Kconfig"
osource "/Users/mrcha033/Documents/hw-cli/.toolchains/zephyr/soc/nuvoton/numaker/Kconfig"
osource "/Users/mrcha033/Documents/hw-cli/.toolchains/zephyr/soc/nuvoton/npcx/Kconfig"
osource "/Users/mrcha033/Documents/hw-cli/.toolchains/zephyr/soc/nuvoton/npcm/Kconfig"
osource "/Users/mrcha033/Documents/hw-cli/.toolchains/zephyr/soc/nordic/Kconfig"
osource "/Users/mrcha033/Documents/hw-cli/.toolchains/zephyr/soc/neorv32/Kconfig"
osource "/Users/mrcha033/Documents/hw-cli/.toolchains/zephyr/soc/native/inf_clock/Kconfig"
osource "/Users/mrcha033/Documents/hw-cli/.toolchains/zephyr/soc/microchip/sam/Kconfig"
osource "/Users/mrcha033/Documents/hw-cli/.toolchains/zephyr/soc/microchip/miv/Kconfig"
osource "/Users/mrcha033/Documents/hw-cli/.toolchains/zephyr/soc/microchip/mec/Kconfig"
osource "/Users/mrcha033/Documents/hw-cli/.toolchains/zephyr/soc/mediatek/mt8xxx/Kconfig"
osource "/Users/mrcha033/Documents/hw-cli/.toolchains/zephyr/soc/lowrisc/opentitan/Kconfig"
osource "/Users/mrcha033/Documents/hw-cli/.toolchains/zephyr/soc/litex/litex_vexriscv/Kconfig"
osource "/Users/mrcha033/Documents/hw-cli/.toolchains/zephyr/soc/ite/ec/Kconfig"
osource "/Users/mrcha033/Documents/hw-cli/.toolchains/zephyr/soc/intel/raptor_lake/Kconfig"
osource "/Users/mrcha033/Documents/hw-cli/.toolchains/zephyr/soc/intel/lakemont/Kconfig"
osource "/Users/mrcha033/Documents/hw-cli/.toolchains/zephyr/soc/intel/intel_socfpga_std/Kconfig"
osource "/Users/mrcha033/Documents/hw-cli/.toolchains/zephyr/soc/intel/intel_socfpga/Kconfig"
osource "/Users/mrcha033/Documents/hw-cli/.toolchains/zephyr/soc/intel/intel_niosv/Kconfig"
osource "/Users/mrcha033/Documents/hw-cli/.toolchains/zephyr/soc/intel/intel_ish/Kconfig"
osource "/Users/mrcha033/Documents/hw-cli/.toolchains/zephyr/soc/intel/intel_adsp/Kconfig"
osource "/Users/mrcha033/Documents/hw-cli/.toolchains/zephyr/soc/intel/elkhart_lake/Kconfig"
osource "/Users/mrcha033/Documents/hw-cli/.toolchains/zephyr/soc/intel/atom/Kconfig"
osource "/Users/mrcha033/Documents/hw-cli/.toolchains/zephyr/soc/intel/apollo_lake/Kconfig"
osource "/Users/mrcha033/Documents/hw-cli/.toolchains/zephyr/soc/intel/alder_lake/Kconfig"
osource "/Users/mrcha033/Documents/hw-cli/.toolchains/zephyr/soc/infineon/cat3/Kconfig"
osource "/Users/mrcha033/Documents/hw-cli/.toolchains/zephyr/soc/infineon/cat1c/Kconfig"
osource "/Users/mrcha033/Documents/hw-cli/.toolchains/zephyr/soc/infineon/cat1b/Kconfig"
osource "/Users/mrcha033/Documents/hw-cli/.toolchains/zephyr/soc/infineon/cat1a/Kconfig"
osource "/Users/mrcha033/Documents/hw-cli/.toolchains/zephyr/soc/gd/gd32/Kconfig"
osource "/Users/mrcha033/Documents/hw-cli/.toolchains/zephyr/soc/gaisler/leon3/Kconfig"
osource "/Users/mrcha033/Documents/hw-cli/.toolchains/zephyr/soc/gaisler/gr716a/Kconfig"
osource "/Users/mrcha033/Documents/hw-cli/.toolchains/zephyr/soc/espressif/Kconfig"
osource "/Users/mrcha033/Documents/hw-cli/.toolchains/zephyr/soc/ene/kb1200/Kconfig"
osource "/Users/mrcha033/Documents/hw-cli/.toolchains/zephyr/soc/ene/kb106x/Kconfig"
osource "/Users/mrcha033/Documents/hw-cli/.toolchains/zephyr/soc/efinix/sapphire/Kconfig"
osource "/Users/mrcha033/Documents/hw-cli/.toolchains/zephyr/soc/cdns/xtensa_sample_controller/Kconfig"
osource "/Users/mrcha033/Documents/hw-cli/.toolchains/zephyr/soc/cdns/sample_controller32/Kconfig"
osource "/Users/mrcha033/Documents/hw-cli/.toolchains/zephyr/soc/cdns/dc233c/Kconfig"
osource "/Users/mrcha033/Documents/hw-cli/.toolchains/zephyr/soc/brcm/bcmvk/Kconfig"
osource "/Users/mrcha033/Documents/hw-cli/.toolchains/zephyr/soc/brcm/bcm2712/Kconfig"
osource "/Users/mrcha033/Documents/hw-cli/.toolchains/zephyr/soc/brcm/bcm2711/Kconfig"
osource "/Users/mrcha033/Documents/hw-cli/.toolchains/zephyr/soc/bflb/Kconfig"
osource "/Users/mrcha033/Documents/hw-cli/.toolchains/zephyr/soc/atmel/sam0/Kconfig"
osource "/Users/mrcha033/Documents/hw-cli/.toolchains/zephyr/soc/atmel/sam/Kconfig"
osource "/Users/mrcha033/Documents/hw-cli/.toolchains/zephyr/soc/aspeed/Kconfig"
osource "/Users/mrcha033/Documents/hw-cli/.toolchains/zephyr/soc/arm/Kconfig"
osource "/Users/mrcha033/Documents/hw-cli/.toolchains/zephyr/soc/arm/beetle/Kconfig"
osource "/Users/mrcha033/Documents/hw-cli/.toolchains/zephyr/soc/antmicro/myra/Kconfig"
osource "/Users/mrcha033/Documents/hw-cli/.toolchains/zephyr/soc/andestech/Kconfig"
osource "/Users/mrcha033/Documents/hw-cli/.toolchains/zephyr/soc/amd/acp_6_0/Kconfig"
osource "/Users/mrcha033/Documents/hw-cli/.toolchains/zephyr/soc/ambiq/Kconfig"
osource "/Users/mrcha033/Documents/hw-cli/.toolchains/zephyr/soc/aesc/Kconfig"
osource "/Users/mrcha033/Documents/hw-cli/.toolchains/zephyr/soc/adi/max32/Kconfig"
```

## projects/golden_rp2040_usb_hid/history/iterations/0003/firmware/zephyr/boards/arm/rp2040_usb_device/rp2040_usb_device_defconfig
```kconfig
CONFIG_RESET=y
CONFIG_CLOCK_CONTROL=y
CONFIG_USE_DT_CODE_PARTITION=y
CONFIG_BUILD_OUTPUT_UF2=y
CONFIG_BUILD_OUTPUT_HEX=y
```

## projects/golden_rp2040_usb_hid/history/iterations/0004/firmware/zephyr/boards/arm/rp2040_usb_device/board.yml
```yaml
board:
  name: rp2040_usb_device
  full_name: HW Co-design RP2040 USB Device
  vendor: hw
  socs:
    - name: rp2040
```
